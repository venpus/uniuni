## boards/arm/eb01_pcb_reva/Kconfig.defconfig
```kconfig
# Copyright (c) 2023 Nordic Semiconductor ASA
# SPDX-License-Identifier: Apache-2.0

if BOARD_EB01_PCB_REVA

config BOARD
	default "eb01_pcb_reva"

config BT_CTLR
   default BT

endif
```
